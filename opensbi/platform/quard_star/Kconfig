## opensbi/platform/quard_star/Kconfig
```kconfig
# SPDX-License-Identifier: BSD-2-Clause

config PLATFORM_QUARD_STAR
	bool
	select FDT
	select FDT_DOMAIN
	select FDT_SERIAL
	select FDT_SERIAL_UART8250
	select FDT_IRQCHIP
	select FDT_IRQCHIP_PLIC
	select FDT_TIMER
	select FDT_TIMER_MTIMER
	select FDT_IPI
	select FDT_IPI_MSWI
	default y
```
